/**
 * @cliArgs --device "MSPM0G350X" --part "Default" --package "LQFP-64(PM)" --product "mspm0_sdk@2.04.00.06"
 * @versions {"tool":"1.22.0+3893"}
 */

/**
 * Import the modules used in this configuration.
 */
const DAC12  = scripting.addModule("/ti/driverlib/DAC12");
const GPIO   = scripting.addModule("/ti/driverlib/GPIO", {}, false);
const GPIO1  = GPIO.addInstance();
const SYSCTL = scripting.addModule("/ti/driverlib/SYSCTL");
const TIMER  = scripting.addModule("/ti/driverlib/TIMER", {}, false);
const TIMER1 = TIMER.addInstance();

/**
 * Write custom configuration values to the imported modules.
 */
const gate8  = system.clockTree["MFPCLKGATE"];
gate8.enable = true;

DAC12.dacFIFOEn            = true;
DAC12.dacFIFOTrigger       = "HWTRIG0";
DAC12.sub0ChanID           = 1;
DAC12.dacEnabledInterrupts = ["FIFO_TWO_QTRS_EMPTY"];
DAC12.dacSampleTimerEn     = false;
DAC12.dacOutputPinEn       = true;
DAC12.dacAmplifier         = "ON";
DAC12.OutPinConfig.$name   = "ti_driverlib_gpio_GPIOPinGeneric0";

const Board = scripting.addModule("/ti/driverlib/Board", {}, false);

GPIO1.$name                               = "BUILTIN";
GPIO1.associatedPins[0].$name             = "LED1";
GPIO1.associatedPins[0].assignedPort      = "PORTA";
GPIO1.associatedPins[0].assignedPin       = "0";
GPIO1.associatedPins[0].launchPadShortcut = "LED1En";

SYSCTL.MFPCLKEn              = true;
SYSCTL.enableSleepOnExit     = true;
SYSCTL.forceDefaultClkConfig = true;
SYSCTL.clockTreeEn           = true;

TIMER1.$name                       = "TIMER_0";
TIMER1.timerClkSrc                 = "LFCLK";
TIMER1.timerMode                   = "PERIODIC";
TIMER1.timerPeriod                 = "1 ms";
TIMER1.event1PublisherChannel      = 1;
TIMER1.event1ControllerInterruptEn = ["ZERO_EVENT"];
TIMER1.peripheral.$assign          = "TIMG0";

/**
 * Pinmux solution for unlocked pins/peripherals. This ensures that minor changes to the automatic solver in a future
 * version of the tool will not impact the pinmux you originally saw.  These lines can be completely deleted in order to
 * re-solve from scratch.
 */
DAC12.peripheral.$suggestSolution            = "DAC0";
DAC12.peripheral.OutPin.$suggestSolution     = "PA15";
Board.peripheral.$suggestSolution            = "DEBUGSS";
Board.peripheral.swclkPin.$suggestSolution   = "PA20";
Board.peripheral.swdioPin.$suggestSolution   = "PA19";
GPIO1.associatedPins[0].pin.$suggestSolution = "PA0";
